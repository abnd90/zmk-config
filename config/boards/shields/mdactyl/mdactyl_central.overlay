/*
 * Copyright (c) 2020 Pete Johanson
 *
 * SPDX-License-Identifier: MIT
 */

#include "mdactyl.dtsi"

&default_transform {
    col-offset = <12>;
	row-offset = <6>;
};

&kscan0 {
	col-gpios
		= ;
	row-gpios
		= ;
};